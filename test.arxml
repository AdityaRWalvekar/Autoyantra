AUTOSAR XML (schema 4.0)
package /FlsConfig
  module config Fls
    FlsGeneral (): FlsMaxSectors=16, FlsVersionInfoApi=1, FlsDevErrorDetect=true
